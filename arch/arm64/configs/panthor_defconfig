## arch/arm64/configs/panthor_defconfig
```kconfig
CONFIG_DRM=m
CONFIG_DRM_GPUVM=m
CONFIG_DRM_EXEC=m
CONFIG_DRM_SCHED=m
CONFIG_IOMMU_SUPPORT=y
CONFIG_IOMMU_IO_PGTABLE_LPAE=y
CONFIG_DRM_GEM_SHMEM_HELPER=m
CONFIG_PM_DEVFREQ=y
CONFIG_DEVFREQ_GOV_SIMPLE_ONDEMAND=y
CONFIG_DRM_PANTHOR=m
CONFIG_ROCKCHIP_REGULATOR_COUPLER=y
```
